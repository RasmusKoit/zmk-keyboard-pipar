#include "pipar_point_zmk_common.dtsi"

/ {
    chosen {
        zmk,battery = &charger;
    };

    indicators {
        compatible = "gpio-leds";
        ble_connection_led: led_ble_connection {
            gpios = <&gpio1 12 GPIO_ACTIVE_HIGH>;
            label = "BLE connection LED";
        };
    };
};
