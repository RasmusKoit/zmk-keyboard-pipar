## boards/piparkeyboards/pipar_chip/Kconfig.pipar_chip
```kconfig
config BOARD_PIPAR_CHIP
    select SOC_NRF52840_QIAA
    select ZMK_BOARD_COMPAT
    imply RETAINED_MEM
    imply RETENTION
    imply RETENTION_BOOT_MODE
```

## boards/piparkeyboards/pipar_dev/board.yml
```yaml
boards:
  - name: pipar_dev
    vendor: piparkeyboards
    socs:
      - name: nrf52840
```

## drivers/Kconfig
```kconfig
menu "Pipar Drivers"

rsource "indicator/Kconfig"
rsource "caps_word/Kconfig"
rsource "watchdog/Kconfig"

endmenu
```

## drivers/watchdog/Kconfig
```kconfig
config PIPAR_WATCHDOG_FEEDER
    bool "Pipar recovery watchdog feeder"
    default n
    depends on TASK_WDT && WATCHDOG
    help
      Feeds a task watchdog from the system workqueue so the device
      auto-resets if the workqueue hangs (e.g., a stuck I2C transfer
      or any work handler that never returns).

config PIPAR_WATCHDOG_TASK_TIMEOUT_MS
    int "Task watchdog timeout (ms)"
    default 8000
    range 1000 30000
    depends on PIPAR_WATCHDOG_FEEDER
    help
      If the system workqueue doesn't feed the watchdog within this
      timeout, the device resets.

config PIPAR_WATCHDOG_FEED_INTERVAL_MS
    int "Watchdog feed interval (ms)"
    default 2000
    range 100 10000
    depends on PIPAR_WATCHDOG_FEEDER
    help
      How often the feeder schedules itself to feed the watchdog.
      Should be substantially less than the task timeout to allow
      for normal workqueue jitter.
```

## west.yml
```yaml
manifest:
  remotes:
    - name: urob
      url-base: https://github.com/urob
    - name: filippor
      url-base: https://github.com/filippor
    - name: RasmusKoit
      url-base: https://github.com/RasmusKoit
  projects:
    - name: zmk-unicode
      remote: urob
      revision: 6ce21267e497e20ff9e05da16d4eefcdd3e89190 # main, 2026-10-08: "Include keys.h"
    - name: kb_zmk_ps2_mouse_trackpoint_driver
      remote: RasmusKoit
      revision: pipar-stability
```
