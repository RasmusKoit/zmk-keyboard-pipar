## boards/piparkeyboards/pipar_chip/Kconfig.defconfig
```kconfig
if BOARD_PIPAR_CHIP

config BOARD_ENABLE_DCDC
    bool "Enable DCDC mode"
    select SOC_DCDC_NRF52X
    default y

config ZMK_KEYBOARD_NAME
    default "Pipar Chip"

if USB_DEVICE_STACK

config USB_NRFX
    default y

endif # USB_DEVICE_STACK

config BT_CTLR
    default BT

endif # BOARD_PIPAR_CHIP
```

## boards/piparkeyboards/pipar_chip/board.yml
```yaml
boards:
  - name: pipar_chip
    vendor: piparkeyboards
    socs:
      - name: nrf52840
```

## boards/piparkeyboards/pipar_point/Kconfig
```kconfig
# This file can add Kconfig settings which are specific to the current board.
# A board specific setting should be defining a custom setting and usually with a prompt

config PIPAR_POINT_RIGHT
    bool "Pipar Point Right"
    default n
    help
      Select this option to build for the right side of the Pipar Point keyboard.

config PIPAR_POINT_LEFT
    bool "Pipar Point Left"
    default n
    help
      Select this option to build for the left side of the Pipar Point keyboard.

config PIPAR_POINT_TRACKPOINT
    bool "Pipar Point Trackpoint"
    select SERIAL
    select UART_ASYNC_API
    default n
    depends on PIPAR_POINT_RIGHT
    help
      Select this option to enable Trackpoint support on the Pipar Point keyboard.
```

## boards/piparkeyboards/pipar_point/Kconfig.defconfig
```kconfig
# Board-specific default values for Kconfig options.
# some values taken from birdsong

if BOARD_PIPAR_POINT

# configdefault BT_DIS_MANUF_NAME_STR
#     default "Pipar Keyboards"
# configdefault BT_DIS_MODEL_NUMBER_STR
#     default "Pipar Point"
# configdefault USB_DEVICE_MANUFACTURER
#     default "PiparKeyboards"
config BOARD
    default "pipar_point"
config ZMK_SPLIT
    default y
config ZMK_BLE
    default y

endif # BOARD_PIPAR_POINT
```

## boards/piparkeyboards/pipar_point/Kconfig.pipar_point
```kconfig
# A shared Kconfig file which can be sourced both in Zephyr Kconfig and sysbuild Kconfig trees.
# This file selects the SoC in the Kconfig tree and potential other SoC related Kconfig settings.
# This file must not select anything outside the re-usable Kconfig board and SoC trees.

rsource "Kconfig.defconfig"

config BOARD_PIPAR_POINT
    select SOC_NRF52840_QIAA
    select ARM_MPU
    imply RETAINED_MEM
    imply RETENTION
    imply RETENTION_BOOT_MODE
    help
      Enable support for the Pipar Point board using the nRF52840 SoC.
```

## boards/piparkeyboards/pipar_point/board.yml
```yaml
board:
  name: pipar_point
  vendor: piparkeyboards
  socs:
    - name: nrf52840
  revision:
    format: custom
    default: 'right'
    exact: true
    revisions:
      - name: left
      - name: right
```

## boards/piparkeyboards/pipar_point/pipar_point_left_defconfig
```kconfig
CONFIG_PIPAR_POINT_LEFT=y

# Peripheral LED indicators
CONFIG_PIPAR_BLE_CONNECTION_INDICATOR=y
```

## boards/piparkeyboards/pipar_point/pipar_point_right_defconfig
```kconfig
CONFIG_PIPAR_POINT_RIGHT=y

CONFIG_ZMK_POINTING=y
CONFIG_ZMK_POINTING_SMOOTH_SCROLLING=y

CONFIG_ZMK_BLE_EXPERIMENTAL_FEATURES=y
CONFIG_ZMK_BLE_PASSKEY_ENTRY=y

CONFIG_ZMK_KEYBOARD_NAME="Pipar Point"
CONFIG_ZMK_SPLIT_ROLE_CENTRAL=y
CONFIG_ZMK_STUDIO=y
CONFIG_ZMK_USB=y

CONFIG_ZMK_USB_LOGGING=n
CONFIG_ZMK_LOGGING_MINIMAL=y
CONFIG_PS2_LOG_LEVEL_DBG=n
CONFIG_UART_LOG_LEVEL_DBG=n
CONFIG_LOG_MODE_IMMEDIATE=n
CONFIG_CBPRINTF_COMPLETE=y

CONFIG_SERIAL=y

# Caps lock LED indicator
CONFIG_PIPAR_CAPS_INDICATOR=y
# Connection type LED indicator
CONFIG_PIPAR_CONNECTION_INDICATOR=y

# Battery reporting - use voltage-based method with YDL375678 profile
CONFIG_ZMK_BATTERY_REPORTING_FETCH_MODE_LITHIUM_VOLTAGE=y
CONFIG_ZMK_BATTERY_PROFILE_YDL375678=y
```

## boards/shields/pipar_sool/Kconfig.shield
```kconfig
config SHIELD_PIPAR_SOOL_CENTRAL
    def_bool $(shields_list_contains,pipar_sool_central)

config SHIELD_PIPAR_SOOL_DONGLE
    def_bool $(shields_list_contains,pipar_sool_dongle)

config SHIELD_PIPAR_SOOL_LEFT
    def_bool $(shields_list_contains,pipar_sool_left)

config SHIELD_PIPAR_SOOL_RIGHT
    def_bool $(shields_list_contains,pipar_sool_right)
```

## drivers/caps_word/Kconfig
```kconfig
config PIPAR_CAPS_WORD_EVENT
	bool "Pipar Caps Word State Event"
	default y if DT_HAS_ZMK_BEHAVIOR_CAPS_WORD_ENABLED
	help
	  Override ZMK's caps_word behavior to emit state change events
```

## drivers/indicator/Kconfig
```kconfig
config PIPAR_CAPS_INDICATOR
	bool "Pipar Caps Lock LED Indicator"
	default n
	help
	  Enable caps lock LED indicator support for Pipar keyboards

config PIPAR_CONNECTION_INDICATOR
	bool "Pipar Connection Type LED Indicator"
	default n
	help
	  Enable connection type (BT/USB) LED indicator support for Pipar keyboards

config PIPAR_BATTERY_INDICATOR
	bool "Pipar Battery Low LED Indicator"
	default n
	depends on ZMK_BATTERY_REPORTING
	help
	  Enable battery low LED indicator using npm1300 PMIC LED0.
	  LED turns on when battery drops below the configured threshold.

config PIPAR_BATTERY_LOW_THRESHOLD
	int "Battery low threshold percentage"
	default 20
	range 5 100
	depends on PIPAR_BATTERY_INDICATOR
	help
	  Battery percentage at or below which the low battery LED turns on.

config PIPAR_BLE_CONNECTION_INDICATOR
	bool "Pipar BLE Connection LED Indicator"
	default n
	depends on ZMK_SPLIT
	help
	  Enable BLE connection LED indicator for split peripheral.
	  LED is solid when connected to central, blinks when disconnected.

config PIPAR_HID_INDICATOR
	bool "Pipar HID Indicator LED"
	default n
	depends on ZMK_HID_INDICATORS
	help
	  Enable an LED driven by a configurable HID indicator bit.
	  Can be used to show Num Lock, Scroll Lock, or any other
	  HID indicator state.

config PIPAR_HID_INDICATOR_BIT
	int "HID indicator bit"
	default 0
	range 0 4
	depends on PIPAR_HID_INDICATOR
	help
	  Which HID indicator bit drives the LED.
	  0 = Num Lock, 1 = Caps Lock, 2 = Scroll Lock,
	  3 = Compose, 4 = Kana.

config PIPAR_HID_INDICATOR_INVERTED
	bool "Invert HID indicator logic"
	default n
	depends on PIPAR_HID_INDICATOR
	help
	  When enabled, LED turns on when the HID indicator is OFF.
	  Useful when the OS has the indicator on by default (e.g. Num Lock).
```
